#include "display_manager.h"
#include "u8g2_esp32_hal.h"
#include "config.h"
#include "system_types.h"
#include <stdio.h>
#include <string.h>

#include "freertos/FreeRTOS.h"
#include "freertos/task.h"
#include <freertos/queue.h>

static const uint8_t image_controller_bits[] = {0x60, 0xc0, 0x00, 0x18, 0x00, 0x03, 0x04, 0x00, 0x04, 0x32, 0x80, 0x09, 0x0a,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 0x71, 0x00};
static const uint8_t image_layout_bits[] = {0xff, 0xff, 0xff, 0xff, 0xff, 0xff, 0xff, 0xff, 0xff, 0xff, 0xff, 0xff, 0x1f,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 0x00, 0x00};
static const uint8_t image_radar_bits[] = {0x80, 0x3f, 0x00, 0x60, 0xc0, 0x00, 0x10, 0x00, 0x01, 0x08, 0x1f, 0x02, 0xc4,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 0x3b, 0x00};
static const uint8_t image_transmitter_bits[] = {0xe0, 0x09, 0x00, 0x18, 0x48, 0x04, 0x04, 0x48, 0x01, 0xe2, 0x48, 0x02, 0x12,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 0x91, 0x00};

static u8g2_t u8g2;

// const uint8_t *system_status_img_l[] = {image_radar_bits, image_radar_bits, image_controller_bits, image_transmitter_bits, image_transmitter_bits};
// string system_status_l[] = {"menu", "scanner", "controller", "transmisor", "broker"};
const uint8_t *system_status_img_l[] = {image_radar_bits, image_controller_bits, image_transmitter_bits};
string system_status_l[] = {"scanner", "controller", "transmisor"};

static string system_status;
// static const uint8_t *system_status_img;
static int system_status_num;

extern QueueHandle_t button_queue;

void display_init(void)
{

    u8g2_esp32_hal_t hal = U8G2_ESP32_HAL_DEFAULT;
    hal.bus.i2c.sda = DISPLAY_SDA;
    hal.bus.i2c.scl = DISPLAY_SCL;

    u8g2_esp32_hal_init(hal);

    u8g2_Setup_ssd1306_i2c_128x64_noname_f(
        &u8g2,
        U8G2_R0,
        u8g2_esp32_i2c_byte_cb,
        u8g2_esp32_gpio_and_delay_cb);

    u8g2_SetI2CAddress(&u8g2, 0x78);
    u8g2_InitDisplay(&u8g2);
    u8g2_SetPowerSave(&u8g2, 0);
    u8g2_ClearBuffer(&u8g2);

    strcpy(system_status, system_status_l[0]);
    // system_status_img = system_status_img_l[0];
    system_status_num = 0;
}

void task_display_draw(void *pvParameters)
{
    display_init();
    int cont = 0;
    system_message recived_msg;

    while (1)
    {
        display_status_update(cont);
        display_show_menu();

        // printf("[Monitor] display update, status %s\n", system_status);

        if (xQueueReceive(button_queue, &recived_msg, portMAX_DELAY))
        {
            printf("[Input] button %s pressed\n", recived_msg.text);

            switch (recived_msg.id)
            {
            case 0:
                cont--;
                break;
            case 1:
                cont++;
                break;
            default:
                break;
            }

            if (cont > 2)
            {
                cont = 0;
            }
            else if (cont < 0)
            {
                cont = 2;
            }
        }

        vTaskDelay(100 / portTICK_PERIOD_MS);
    }
}

void display_status_update(int new_system_status)
{
    // system_status = system_status_l[new_system_status];
    strcpy(system_status, system_status_l[new_system_status]);
    // system_status_img = system_status_img_l[new_system_status];
    system_status_num = new_system_status;
}

void display_show_menu(void)
{
    u8g2_ClearBuffer(&u8g2);
    u8g2_SetBitmapMode(&u8g2, 1);
    u8g2_SetFontMode(&u8g2, 1);

    // battery
    u8g2_SetFont(&u8g2, u8g2_font_4x6_tr);
    u8g2_DrawStr(&u8g2, 5, 10, "75%");

    char title[30] = "| Select: ";
    // CAMBIAR POR UN ARRAY DE CHARS
    snprintf(title + strlen(title), sizeof(title) - strlen(title), "%s", system_status);

    // head data - station address - time
    u8g2_DrawStr(&u8g2, 19, 10, title);
    u8g2_DrawStr(&u8g2, 2, 38, "MAC: 00:1A:2B:3C:4D:5E");
    u8g2_SetFont(&u8g2, u8g2_font_timR14_tr);
    u8g2_DrawStr(&u8g2, 2, 30, "11:21 a.m.");

    // btm text
    u8g2_SetFont(&u8g2, u8g2_font_4x6_tr);
    u8g2_DrawStr(&u8g2, 5, 59, "3 Nodes sync | 2 - 1");

    int top_i = (system_status_num + 2) % 3;
    u8g2_DrawXBM(&u8g2, 105, -5, 21, 21, system_status_img_l[top_i]);

    int btm_i = (system_status_num + 1) % 3;
    u8g2_DrawXBM(&u8g2, 105, 49, 21, 21, system_status_img_l[btm_i]);

    u8g2_DrawXBM(&u8g2, 105, 22, 21, 21, system_status_img_l[system_status_num]);

    // layout
    u8g2_DrawXBM(&u8g2, 2, 2, 126, 61, image_layout_bits);
    u8g2_SendBuffer(&u8g2);
}

void display_update(void)
{
    u8g2_SendBuffer(&u8g2);
}